## Kconfig
```kconfig
# SPDX-License-Identifier: MIT

config ZMK_INPUT_MLX90393
	bool "MLX90393 magnetic sensor input driver"
	default n
	depends on DT_HAS_MELEXIS_MLX90393_INPUT_ENABLED
	depends on I2C
	select SENSOR
	select INPUT
	help
	  Enable driver for MLX90393 magnetic sensor input.
	  This driver reads magnetic field data from the MLX90393 sensor
	  and generates mouse input events based on Z-axis threshold detection.

if ZMK_INPUT_MLX90393

config ZMK_INPUT_MLX90393_INIT_PRIORITY
	int "MLX90393 driver initialization priority"
	default 80
	help
	  Initialization priority for MLX90393 driver.

config ZMK_INPUT_MLX90393_LOG_LEVEL
	int "MLX90393 driver log level"
	default 3
	range 0 4
	help
	  Log level for MLX90393 driver.
	  0 = OFF, 1 = ERROR, 2 = WARNING, 3 = INFO, 4 = DEBUG

endif # ZMK_INPUT_MLX90393
```

## dts/bindings/input/melexis,mlx90393-input.yaml
```yaml
# SPDX-License-Identifier: MIT

description: |
  MLX90393 magnetic sensor input driver

  Reads magnetic field data from the MLX90393 via I2C and reports
  relative X/Y/WHEEL events. Z-axis press detection is supported via
  threshold with hysteresis and reported as a button event.

  Example usage:
    mlx90393_input: mlx90393-input@0c {
      compatible = "melexis,mlx90393-input";
      reg = <0x0C>;
      polling-interval-ms = <10>;
      deadzone-x = <3>;
      deadzone-y = <3>;
      deadzone-z = <5>;
      z-press-threshold = <50>;
      z-hysteresis = <10>;
    };

compatible: "melexis,mlx90393-input"

include: [base.yaml, i2c-device.yaml]

properties:
  polling-interval-ms:
    type: int
    default: 10
    description: |
      Sensor reading interval in milliseconds.
      Affects responsiveness vs power consumption.

  z-press-threshold:
    type: int
    default: 50
    description: |
      Z-axis threshold value for press detection.
      Values above this threshold trigger pressed state.

  z-hysteresis:
    type: int
    default: 10
    description: |
      Z-axis hysteresis value to prevent state oscillation.
      Press state is released when Z falls below (threshold - hysteresis).

  deadzone-x:
    type: int
    default: 3
    description: X-axis deadzone to filter small movements.

  deadzone-y:
    type: int
    default: 3
    description: Y-axis deadzone to filter small movements.

  deadzone-z:
    type: int
    default: 5
    description: Z-axis deadzone to filter small movements.

  conv-delay-ms:
    type: int
    default: 100
    description: |
      Conversion delay in milliseconds between start command and read
      of measurement results.

  scale-x:
    type: int
    default: 4
    description: Divisor applied to relative X after deadzone.

  scale-y:
    type: int
    default: 4
    description: Divisor applied to relative Y after deadzone.

  scale-z:
    type: int
    default: 4
    description: Divisor applied to relative Z after deadzone.

  disable-wheel:
    type: boolean
    description: |
      When present, disables reporting of REL_WHEEL from Z-axis movement.
      Z-press detection remains active.

  disable-press:
    type: boolean
    description: |
      When present, disables reporting of BTN_MIDDLE based on Z-axis
      press threshold/hysteresis. Use this to avoid host-side auto-scroll
      that some OSs trigger on middle-button hold.

  x-hysteresis:
    type: int
    default: 0
    description: |
      X-axis hysteresis width for Schmitt gating around the deadzone.
      Active when value rises above deadzone; deactivates only when it
      falls below (deadzone - x-hysteresis). Set 0 to disable.

  y-hysteresis:
    type: int
    default: 0
    description: |
      Y-axis hysteresis width for Schmitt gating around the deadzone.
      Active when value rises above deadzone; deactivates only when it
      falls below (deadzone - y-hysteresis). Set 0 to disable.

  report-threshold-x:
    type: int
    default: 1
    description: |
      Minimum absolute X value (after deadzone, hysteresis, scaling)
      required to report a movement. Values below are suppressed.

  report-threshold-y:
    type: int
    default: 1
    description: |
      Minimum absolute Y value (after deadzone, hysteresis, scaling)
      required to report a movement. Values below are suppressed.

  middle-hold-release-ms:
    type: int
    default: 200
    description: |
      When non-pressed XY movement is detected, the driver will press and hold
      the middle mouse button, and release it after this many milliseconds of
      inactivity. Set to 0 to disable auto-hold behavior.
```
